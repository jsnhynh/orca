## src/linux/configs/orca_rv32_nommu_defconfig
```kconfig
# orca: rv32ima (no c, no fpu), no mmu, machine-mode kernel, busybox initramfs.
# started from buildroot 2026.08 qemu_riscv32_nommu_virt_defconfig.
BR2_riscv=y
BR2_riscv_custom=y
BR2_RISCV_ISA_RVM=y
BR2_RISCV_ISA_RVA=y
# BR2_RISCV_ISA_RVF is not set
# BR2_RISCV_ISA_RVD is not set
# BR2_RISCV_ISA_RVC is not set
BR2_RISCV_32=y
# BR2_RISCV_USE_MMU is not set
BR2_RISCV_ABI_ILP32=y
BR2_PACKAGE_HOST_LINUX_HEADERS_CUSTOM_6_18=y
BR2_TARGET_GENERIC_HOSTNAME="orca"
BR2_TARGET_GENERIC_ISSUE="ORCA RV32IMA no-MMU Linux"
BR2_TARGET_GENERIC_GETTY_PORT="ttyS0"
BR2_TARGET_GENERIC_GETTY_BAUDRATE_KEEP=y
BR2_LINUX_KERNEL=y
BR2_LINUX_KERNEL_CUSTOM_VERSION=y
BR2_LINUX_KERNEL_CUSTOM_VERSION_VALUE="6.18.7"
BR2_LINUX_KERNEL_USE_CUSTOM_CONFIG=y
BR2_LINUX_KERNEL_CUSTOM_CONFIG_FILE="$(BR2_EXTERNAL_ORCA_PATH)/board/orca/linux.config"
BR2_LINUX_KERNEL_DTS_SUPPORT=y
BR2_LINUX_KERNEL_CUSTOM_DTS_PATH="$(BR2_EXTERNAL_ORCA_PATH)/board/orca/orca-sim.dts $(BR2_EXTERNAL_ORCA_PATH)/board/orca/orca-kv260-150-jtag.dts $(BR2_EXTERNAL_ORCA_PATH)/board/orca/orca-kv260-200-jtag.dts"
BR2_TARGET_ROOTFS_CPIO=y
BR2_TARGET_ROOTFS_INITRAMFS=y
# BR2_TARGET_ROOTFS_TAR is not set
BR2_PACKAGE_HOST_QEMU=y
BR2_PACKAGE_HOST_QEMU_SYSTEM_MODE=y
# no networking in the kernel; skip the ifupdown init script
# BR2_PACKAGE_IFUPDOWN_SCRIPTS is not set
```
